## Kconfig
```kconfig
mainmenu "EMS (Embedded Middleware System) Configuration"

config EMS_VERSION
	string
	default "1.0.0"

# ============================================================================
# Build Configuration
# ============================================================================

menu "Build Options"

config BUILD_TYPE_DEBUG
	bool "Debug build"
	default n
	help
	  Enable debug symbols (-g), disable optimizations (-O0), and enable
	  verbose logging. Equivalent to CMAKE_BUILD_TYPE=Debug.
	  
	  If unsure, say N for production builds.

choice
	prompt "Optimization level"
	default OPT_O2 if !BUILD_TYPE_DEBUG
	default OPT_O0 if BUILD_TYPE_DEBUG
	help
	  Select compiler optimization level.

config OPT_O0
	bool "No optimization (-O0)"
	help
	  Disable all optimizations. Best for debugging with GDB.

config OPT_O2
	bool "Optimize for speed (-O2)"
	help
	  Standard optimization level. Good balance of speed and size.

config OPT_O3
	bool "Aggressive optimization (-O3)"
	help
	  Maximum speed optimization. May increase binary size.

config OPT_OS
	bool "Optimize for size (-Os)"
	help
	  Optimize for minimal binary size. Good for embedded systems.

endchoice

config BUILD_TESTING
	bool "Build unit tests"
	default y
	help
	  Build the test suite (ems-test, osal-test, hal-test, etc.).
	  Requires test framework to be available.

config BUILD_SHARED_LIBS
	bool "Build shared libraries"
	default n
	help
	  Build .so shared libraries instead of .a static libraries.
	  
	  If unsure, say N for embedded systems.

config INSTALL_HEADERS
	bool "Install development headers"
	default y
	help
	  Install public header files for library development.

endmenu

# ============================================================================
# Architecture Selection
# ============================================================================

choice
	prompt "Target architecture"
	default ARCH_X86_64
	help
	  Select the target CPU architecture.

config ARCH_X86_64
	bool "x86_64 (64-bit Intel/AMD)"

config ARCH_ARM32
	bool "ARM32 (ARMv7-A)"

config ARCH_ARM64
	bool "ARM64 (ARMv8-A / AArch64)"

config ARCH_RISCV64
	bool "RISC-V 64-bit"

endchoice

config CROSS_COMPILE
	string "Cross-compiler prefix"
	default "" if ARCH_X86_64
	default "arm-linux-gnueabihf-" if ARCH_ARM32
	default "aarch64-linux-gnu-" if ARCH_ARM64
	default "riscv64-linux-gnu-" if ARCH_RISCV64
	help
	  Prefix for cross-compilation toolchain (e.g., "arm-linux-gnueabihf-").
	  Leave empty for native compilation.

# ============================================================================
# OSAL Configuration
# ============================================================================

menu "OSAL (Operating System Abstraction Layer)"
source "core/osal/Kconfig"
endmenu

# ============================================================================
# HAL Configuration
# ============================================================================

menu "HAL (Hardware Abstraction Layer)"
source "core/hal/Kconfig"
endmenu

# ============================================================================
# PCL Configuration
# ============================================================================

menu "PCL (Peripheral Configuration Library)"
source "core/pcl/Kconfig"
endmenu

# ============================================================================
# PDL Configuration
# ============================================================================

menu "PDL (Peripheral Driver Layer)"
source "core/pdl/Kconfig"
endmenu

# ============================================================================
# ACL Configuration
# ============================================================================

menu "ACL (Application Configuration Layer)"
source "core/acl/Kconfig"
endmenu

# ============================================================================
# Product Selection
# ============================================================================

choice
	prompt "Product line"
	default PRODUCT_PMC
	help
	  Select the target product line.

config PRODUCT_PMC
	bool "PMC (Power Management Controller)"
	help
	  Build for PMC product line (satellite power management).

config PRODUCT_SAMPLES
	bool "Sample applications"
	help
	  Build sample/demo applications only.

endchoice

menu "Product Configuration"
depends on PRODUCT_PMC || PRODUCT_SAMPLES

if PRODUCT_PMC
source "products/pmc/Kconfig"
endif

if PRODUCT_SAMPLES
source "products/samples/Kconfig"
endif

endmenu

# ============================================================================
# Test Configuration
# ============================================================================

menu "Test Configuration"
depends on BUILD_TESTING
source "tests/Kconfig"
endmenu
```

## apps/Config.in
```kconfig
# ============================================================================
# Application Configuration
# ============================================================================

menu "Apps"

config PRINT_TEST
	bool "Build print_test app"
	help
	  Build the print_test userspace executable.

config SMART_MONITOR
	bool "Build smart_monitor app"
	help
	  Build the smart_monitor userspace executable for reading eMMC
	  SMART data through the Linux MMC ioctl interface.

config MEMORY_MONITOR
	bool "Build memory_monitor app"
	help
	  Build the memory_monitor userspace executable for collecting
	  system, kernel, reserved, process, and thread memory statistics.

config PDEBUG
	bool "Build pdebug app"
	depends on PDI
	help
	  Build the pdebug userspace hardware debug tool. pdebug uses a
	  BusyBox-style function table to dispatch PDI-based discovery, MCU,
	  and LED hardware tests from one executable.

endmenu
```

## configs/ccm_2apps_defconfig
```kconfig
# ============================================================================
# Products Layer Trimming Test Configuration
# ============================================================================
# This configuration demonstrates products layer (libs/apps) trimming.
# Only selected apps are enabled.
# ============================================================================

# Product Selection
CONFIG_PRODUCT_CCM=y
CONFIG_PRODUCT_SAMPLE=n

# Core Components - Full stack
CONFIG_OSAL=y
CONFIG_HAL=y
CONFIG_PCL=y
CONFIG_PDL=y
CONFIG_ACL=y

# OSAL Configuration (use defaults)
CONFIG_OS_LINUX=y
CONFIG_ARCH_X86_64=y
CONFIG_OSAL_BUILD_SHARED=y

# HAL Configuration (use defaults)
CONFIG_PLATFORM_GENERIC_LINUX=y
CONFIG_HAL_BUILD_SHARED=y

# CCM Platform
CONFIG_PROJECT_H200_AM625=y

# ============================================================================
# Products Layer Trimming - Only 2 apps
# ============================================================================

# CCM Libraries - Enable
CONFIG_LIBCCM=y

# CCM Applications - Only enable 2 apps
CONFIG_APP_COLLECTOR=y
CONFIG_APP_COMM=y
CONFIG_APP_HEALTH=n
CONFIG_APP_LOGGER=n
CONFIG_APP_SUPERVISOR=n
```

## configs/ccm_h200_200p_defconfig
```kconfig
# H200-200P Product Configuration
# 完整型号：启用所有应用

# 产品选择
CONFIG_PRODUCT_CCM=y
CONFIG_PRODUCT_SAMPLE=n

# 启用的应用
CONFIG_APP_COLLECTOR=y
CONFIG_APP_COMM=y
CONFIG_APP_HEALTH=y
CONFIG_APP_LOGGER=y
CONFIG_APP_SUPERVISOR=y

# SDK 组件（必需）
CONFIG_OSAL=y
CONFIG_HAL=y
CONFIG_PCL=y
CONFIG_PDL=y
CONFIG_ACL=y

# 产品组件（必需）
CONFIG_H200_AM625=y
CONFIG_LIBCCM=y

# 平台配置
CONFIG_OS_LINUX=y
CONFIG_ARCH_ARM64=y
CONFIG_PCL_PLATFORM_TI_AM625=y
CONFIG_PCL_PRODUCT_H200_200P=y
```

## configs/ctest/ctest_x86_pdi_defconfig
```kconfig
# ============================================================================
# PDI Unit Test Configuration
# ============================================================================
# PDI is the userspace API library for the kernel PDM ioctl ABI.
# This config validates PDI argument handling without requiring pdm.ko loaded.
# ============================================================================

# Architecture and OS
CONFIG_OS_LINUX=y
CONFIG_ARCH_X86_64=y

# Platform
CONFIG_PLATFORM_LINUX=y

# Core Components - OSAL + PDI
CONFIG_OSAL=y
CONFIG_PDI=y
CONFIG_TEST_FRAMEWORK=y

# Build Configuration
CONFIG_OSAL_BUILD_SHARED=y
CONFIG_PDI_BUILD_SHARED=y

# OSAL Features - Required for PDI and test framework
CONFIG_OSAL_IPC=y
CONFIG_OSAL_FILE=y
CONFIG_OSAL_THREAD=y

# OSAL IPC
CONFIG_OSAL_IPC_ATOMIC=y
CONFIG_OSAL_IPC_MUTEX=y

# OSAL Library
CONFIG_OSAL_LIB_ERRNO=y
CONFIG_OSAL_LIB_HEAP=y
CONFIG_OSAL_LIB_STDIO=y
CONFIG_OSAL_LIB_STRING=y

# OSAL System
CONFIG_OSAL_SYS_CLOCK=y
CONFIG_OSAL_SYS_FILE=y
CONFIG_OSAL_SYS_PROCESS=y
CONFIG_OSAL_SYS_THREAD=y
CONFIG_OSAL_SYS_TIME=y

# OSAL Utility
CONFIG_OSAL_UTIL_LOG=y
CONFIG_OSAL_UTIL_VERSION=y

# Testing
CONFIG_BUILD_TESTING=y
CONFIG_TEST_UNIT=y

# PDI Unit Tests
CONFIG_TEST_PDI=y
CONFIG_TEST_PDI_API=y

# Other test modules disabled
# CONFIG_TEST_OSAL is not set
# CONFIG_TEST_HAL is not set
# CONFIG_TEST_PDM is not set
# CONFIG_TEST_PCONFIG is not set
# CONFIG_TEST_ACONFIG is not set
# CONFIG_TEST_PERFORMANCE is not set
# CONFIG_TEST_STRESS is not set
# CONFIG_TEST_SYSTEM is not set
```

## configs/defconfig
```kconfig
#
# EMS Default Configuration
# Optimized for x86_64 platform with all features enabled
#

# ============================================================================
# Build Options
# ============================================================================
CONFIG_OPT_O2=y
CONFIG_LIBRARY_BUILD_TYPE_STATIC=y
CONFIG_LIBRARY_BUILD_TYPE_DYNAMIC=y
CONFIG_INSTALL_HEADERS=y

# ============================================================================
# Architecture
# ============================================================================
CONFIG_ARCH_X86_64=y
CONFIG_CROSS_COMPILE=""

# ============================================================================
# OSAL (Operating System Abstraction Layer)
# ============================================================================
CONFIG_OSAL=y
CONFIG_OSAL_BUILD_STATIC=y
CONFIG_OSAL_BUILD_SHARED=y

# OSAL Features (All enabled)
CONFIG_OSAL_FILE=y
CONFIG_OSAL_NETWORK=y
CONFIG_OSAL_IPC=y
CONFIG_OSAL_THREAD=y

# OSAL Resource Limits
CONFIG_OSAL_MAX_TASKS=128
CONFIG_OSAL_MAX_QUEUES=64
CONFIG_OSAL_MAX_MUTEXES=64
CONFIG_OSAL_MAX_SEMAPHORES=64
CONFIG_OSAL_MAX_TIMERS=32

# ============================================================================
# HAL (Hardware Abstraction Layer)
# ============================================================================
CONFIG_HAL=y
CONFIG_HAL_BUILD_STATIC=y
CONFIG_HAL_BUILD_SHARED=y

# HAL Drivers (All enabled)
CONFIG_HAL_CAN=y
CONFIG_HAL_CAN_DEVICE="can0"
CONFIG_HAL_CAN_BITRATE=500000

CONFIG_HAL_UART=y
CONFIG_HAL_UART_DEVICE="/dev/ttyS0"
CONFIG_HAL_UART_BAUDRATE=115200

CONFIG_HAL_I2C=y
CONFIG_HAL_I2C_DEVICE="/dev/i2c-0"

CONFIG_HAL_SPI=y
CONFIG_HAL_SPI_DEVICE="/dev/spidev0.0"

CONFIG_HAL_GPIO=y
CONFIG_HAL_GPIO_BASE=0

CONFIG_HAL_WATCHDOG=y
CONFIG_HAL_WATCHDOG_DEVICE="/dev/watchdog"
CONFIG_HAL_WATCHDOG_TIMEOUT=30

# ============================================================================
# PCL (Protocol Control Layer)
# ============================================================================
CONFIG_PCL=y
CONFIG_PCL_BUILD_STATIC=y
CONFIG_PCL_BUILD_SHARED=y

# ============================================================================
# PDL (Protocol Data Layer)
# ============================================================================
CONFIG_PDL=y
CONFIG_PDL_BUILD_STATIC=y
CONFIG_PDL_BUILD_SHARED=y

# PDL Modules (All enabled)
CONFIG_PDL_MCU_ENABLE=y
CONFIG_PDL_MCU_PROTOCOL_VERSION=2
CONFIG_PDL_MCU_MAX_DEVICES=16

CONFIG_PDL_SATELLITE_ENABLE=y
CONFIG_PDL_SATELLITE_MAX_DEVICES=32

CONFIG_PDL_BMC_ENABLE=y
CONFIG_PDL_BMC_REDFISH_SUPPORT=y
CONFIG_PDL_BMC_IPMI_SUPPORT=y
CONFIG_PDL_BMC_MAX_SESSIONS=8

CONFIG_PDL_WATCHDOG_SUPPORT=y

# ============================================================================
# ACL (Application Control Layer)
# ============================================================================
CONFIG_ACL=y
CONFIG_ACL_BUILD_STATIC=y
CONFIG_ACL_BUILD_SHARED=y

# ACL Features
CONFIG_ACL_TELEMETRY_CACHE=y
CONFIG_ACL_CACHE_SIZE=512
CONFIG_ACL_CACHE_TIMEOUT=60

# ============================================================================
# Products
# ============================================================================
CONFIG_PRODUCT_CCM=y
CONFIG_PROJECT_H200_AM625=y

# CCM Libraries
CONFIG_BUILD_LIBCCM=y
CONFIG_LIBCCM_BUILD_STATIC=y
CONFIG_LIBCCM_BUILD_SHARED=y

# CCM Applications (All enabled)
CONFIG_BUILD_CCM_SUPERVISOR=y
CONFIG_CCM_SUPERVISOR_PORT=8001
CONFIG_CCM_SUPERVISOR_LOG_LEVEL=2

CONFIG_BUILD_CCM_COLLECTOR=y
CONFIG_CCM_COLLECTOR_INTERVAL=1000
CONFIG_CCM_COLLECTOR_BUFFER_SIZE=4096

CONFIG_BUILD_CCM_COMM=y
CONFIG_CCM_COMM_PORT=8002
CONFIG_CCM_COMM_MAX_CLIENTS=32

CONFIG_BUILD_CCM_HEALTH=y
CONFIG_CCM_HEALTH_CHECK_INTERVAL=5000
CONFIG_CCM_HEALTH_THRESHOLD=80

CONFIG_BUILD_CCM_LOGGER=y
CONFIG_CCM_LOGGER_MAX_SIZE=10485760
CONFIG_CCM_LOGGER_ROTATE_COUNT=5

# ============================================================================
# Debugging Options
# ============================================================================
CONFIG_LOG_LEVEL=2
```

## configs/ems_debug_defconfig
```kconfig
#
# EMS Debug Build Configuration
#

# Build Options
CONFIG_BUILD_TYPE_DEBUG=y
CONFIG_OPT_O0=y
CONFIG_BUILD_TESTING=y
CONFIG_INSTALL_HEADERS=y

# Architecture
CONFIG_ARCH_X86_64=y

# OSAL (increased limits for debugging)
CONFIG_OSAL_MAX_TASKS=128
CONFIG_OSAL_MAX_QUEUES=64
CONFIG_OSAL_MAX_MUTEXES=64
CONFIG_OSAL_DEBUG_LOGGING=y

# HAL (all drivers enabled for testing)
CONFIG_HAL_CAN=y
CONFIG_HAL_CAN_DEVICE="vcan0"
CONFIG_HAL_UART=y
CONFIG_HAL_UART_DEVICE="/dev/ttyUSB0"
CONFIG_HAL_UART_BAUDRATE=115200
CONFIG_HAL_I2C=y
CONFIG_HAL_SPI=y
CONFIG_HAL_GPIO=y
CONFIG_HAL_WATCHDOG=y

# Product
CONFIG_PRODUCT_PMC=y
CONFIG_PROJECT_H200_AM625=y
CONFIG_BUILD_PMC_SUPERVISOR=y
CONFIG_BUILD_PMC_COLLECTOR=y
CONFIG_BUILD_PMC_COMM=y
CONFIG_BUILD_PMC_HEALTH=y
CONFIG_BUILD_PMC_LOGGER=y
```

## configs/ems_release_defconfig
```kconfig
#
# EMS Release Build Configuration
#

# Build Options
# CONFIG_BUILD_TYPE_DEBUG is not set
CONFIG_OPT_OS=y
# CONFIG_BUILD_TESTING is not set
CONFIG_BUILD_SHARED_LIBS=y
CONFIG_INSTALL_HEADERS=y

# Architecture
CONFIG_ARCH_ARM64=y
CONFIG_CROSS_COMPILE="aarch64-linux-gnu-"

# OSAL (minimal limits for production)
CONFIG_OSAL_MAX_TASKS=32
CONFIG_OSAL_MAX_QUEUES=16
CONFIG_OSAL_MAX_MUTEXES=16

# HAL (only required drivers)
CONFIG_HAL_CAN=y
CONFIG_HAL_CAN_DEVICE="can0"
CONFIG_HAL_UART=y
CONFIG_HAL_UART_DEVICE="/dev/ttyS0"
CONFIG_HAL_UART_BAUDRATE=115200
# CONFIG_HAL_I2C is not set
# CONFIG_HAL_SPI is not set
CONFIG_HAL_GPIO=y
CONFIG_HAL_WATCHDOG=y

# Product
CONFIG_PRODUCT_PMC=y
CONFIG_PROJECT_H200_AM625=y
CONFIG_BUILD_PMC_SUPERVISOR=y
CONFIG_BUILD_PMC_COLLECTOR=y
CONFIG_BUILD_PMC_COMM=y
CONFIG_BUILD_PMC_HEALTH=y
CONFIG_BUILD_PMC_LOGGER=y
```

## configs/imx6ull_modules_defconfig
```kconfig
# ============================================================================
# PDM kernel module build configuration
# ============================================================================

CONFIG_PROJECT_NAME="modules"
CONFIG_PROJECT_VERSION="1.0.0"

CONFIG_OS_LINUX=y
CONFIG_ARCH_ARM32=y
CONFIG_PLATFORM_LINUX=y

CONFIG_PDM=m
```
