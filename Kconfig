## configs/tests_x86_osal_defconfig
```kconfig
# ============================================================================
# OSAL Test Configuration
# ============================================================================
# 专注于 OSAL 层的测试配置
# 包含完整的 OSAL 功能和测试，其他模块最小化
# ============================================================================

# Architecture and OS
CONFIG_OS_LINUX=y
CONFIG_ARCH_X86_64=y

# Platform
CONFIG_PLATFORM_LINUX=y

# Core Components - OSAL Only
CONFIG_OSAL=y
CONFIG_TYPES=y

# Build Configuration - Shared Libraries for Testing
CONFIG_OSAL_BUILD_SHARED=y

# OSAL Features - All Enabled
CONFIG_OSAL_IPC=y
CONFIG_OSAL_FILE=y
CONFIG_OSAL_THREAD=y
CONFIG_OSAL_NETWORK=y
CONFIG_OSAL_SIGNAL=y

# OSAL IPC - All Enabled
CONFIG_OSAL_IPC_ATOMIC=y
CONFIG_OSAL_IPC_MUTEX=y
CONFIG_OSAL_IPC_RWLOCK=y
CONFIG_OSAL_IPC_SEMAPHORE=y
CONFIG_OSAL_IPC_COND=y
CONFIG_OSAL_IPC_SHM=y
CONFIG_OSAL_IPC_SHM_CACHE=y

# OSAL Library - All Enabled
CONFIG_OSAL_LIB_ERRNO=y
CONFIG_OSAL_LIB_HEAP=y
CONFIG_OSAL_LIB_STDIO=y
CONFIG_OSAL_LIB_STRING=y
CONFIG_OSAL_LIB_FLOCK=y

# OSAL System - All Enabled
CONFIG_OSAL_SYS_CLOCK=y
CONFIG_OSAL_SYS_ENV=y
CONFIG_OSAL_SYS_FILE=y
CONFIG_OSAL_SYS_POLL=y
CONFIG_OSAL_SYS_PROCESS=y
CONFIG_OSAL_SYS_SCHED=y
CONFIG_OSAL_SYS_SELECT=y
CONFIG_OSAL_SYS_SIGNAL=y
CONFIG_OSAL_SYS_THREAD=y
CONFIG_OSAL_SYS_TIME=y

# OSAL Network - All Enabled
CONFIG_OSAL_NET_SOCKET=y
CONFIG_OSAL_NET_TERMIOS=y

# OSAL Utility - All Enabled
CONFIG_OSAL_UTIL_LOG=y
CONFIG_OSAL_UTIL_VERSION=y

# Testing - OSAL Only
CONFIG_BUILD_TESTING=y
CONFIG_TEST_UNIT=y
CONFIG_TEST_OSAL=y

# Other Modules - Disabled
# CONFIG_HAL is not set
# CONFIG_PCL is not set
# CONFIG_PDL is not set
# CONFIG_PRL is not set
# CONFIG_ACL is not set

# Products - Disabled
# CONFIG_PRODUCT_CCM is not set
```

## configs/ubuntu_x86_mock_modules_defconfig
```kconfig
# ============================================================================
# PDM kernel module build configuration
# ============================================================================

CONFIG_PROJECT_NAME="x86_mock_modules"
CONFIG_PROJECT_VERSION="1.0.0"

CONFIG_OS_LINUX=y
CONFIG_ARCH_X86_64=y
CONFIG_PLATFORM_LINUX=y

CONFIG_PDM=m

CONFIG_PDM_MOCK_DEVICES=y
CONFIG_PDI=y
CONFIG_PDEBUG=y
CONFIG_PDM_DIAG_CONTROL=y
```

## configs/ubuntu_x86_modules_defconfig
```kconfig
# ============================================================================
# PDM kernel module build configuration
# ============================================================================

CONFIG_PROJECT_NAME="x86_modules"
CONFIG_PROJECT_VERSION="1.0.0"

CONFIG_OS_LINUX=y
CONFIG_ARCH_X86_64=y
CONFIG_PLATFORM_LINUX=y

CONFIG_PDM=m
```

## configs/x86_64_full_defconfig
```kconfig
#
# EMS x86_64 Full Configuration
# All features enabled for development and testing on x86_64 platform
#

# ============================================================================
# Build Options
# ============================================================================
CONFIG_BUILD_TYPE_DEBUG=y
CONFIG_OPT_O2=y
CONFIG_LIBRARY_BUILD_TYPE_STATIC=y
CONFIG_LIBRARY_BUILD_TYPE_DYNAMIC=y
CONFIG_INSTALL_HEADERS=y
CONFIG_BUILD_TESTING=y

# ============================================================================
# Architecture
# ============================================================================
CONFIG_ARCH_X86_64=y
CONFIG_CROSS_COMPILE=""

# ============================================================================
# OSAL (Operating System Abstraction Layer)
# ============================================================================
CONFIG_OSAL=y
CONFIG_OSAL_BUILD_STATIC=y
CONFIG_OSAL_BUILD_SHARED=y

# OSAL Features (All enabled)
CONFIG_OSAL_FILE=y
CONFIG_OSAL_NETWORK=y
CONFIG_OSAL_IPC=y
CONFIG_OSAL_THREAD=y

# OSAL Resource Limits (Generous for x86_64)
CONFIG_OSAL_MAX_TASKS=256
CONFIG_OSAL_MAX_QUEUES=128
CONFIG_OSAL_MAX_MUTEXES=128
CONFIG_OSAL_MAX_SEMAPHORES=128
CONFIG_OSAL_MAX_TIMERS=64

# OSAL Debug
CONFIG_OSAL_DEBUG_LOGGING=y
CONFIG_DEBUG_OSAL=y

# ============================================================================
# HAL (Hardware Abstraction Layer)
# ============================================================================
CONFIG_HAL=y
CONFIG_HAL_BUILD_STATIC=y
CONFIG_HAL_BUILD_SHARED=y

# HAL Drivers (All enabled)
CONFIG_HAL_CAN=y
CONFIG_HAL_CAN_DEVICE="can0"
CONFIG_HAL_CAN_BITRATE=500000

CONFIG_HAL_UART=y
CONFIG_HAL_UART_DEVICE="/dev/ttyS0"
CONFIG_HAL_UART_BAUDRATE=115200

CONFIG_HAL_I2C=y
CONFIG_HAL_I2C_DEVICE="/dev/i2c-0"

CONFIG_HAL_SPI=y
CONFIG_HAL_SPI_DEVICE="/dev/spidev0.0"

CONFIG_HAL_GPIO=y
CONFIG_HAL_GPIO_BASE=0

CONFIG_HAL_WATCHDOG=y
CONFIG_HAL_WATCHDOG_DEVICE="/dev/watchdog"
CONFIG_HAL_WATCHDOG_TIMEOUT=30

# HAL Debug
CONFIG_DEBUG_HAL=y

# ============================================================================
# PCL (Protocol Control Layer)
# ============================================================================
CONFIG_PCL=y
CONFIG_PCL_BUILD_STATIC=y
CONFIG_PCL_BUILD_SHARED=y
CONFIG_DEBUG_PCL=y

# ============================================================================
# PDL (Protocol Data Layer)
# ============================================================================
CONFIG_PDL=y
CONFIG_PDL_BUILD_STATIC=y
CONFIG_PDL_BUILD_SHARED=y

# PDL Modules (All enabled)
CONFIG_PDL_MCU_ENABLE=y
CONFIG_PDL_MCU_PROTOCOL_VERSION=2
CONFIG_PDL_MCU_MAX_DEVICES=16

CONFIG_PDL_SATELLITE_ENABLE=y
CONFIG_PDL_SATELLITE_MAX_DEVICES=32

CONFIG_PDL_BMC_ENABLE=y
CONFIG_PDL_BMC_REDFISH_SUPPORT=y
CONFIG_PDL_BMC_IPMI_SUPPORT=y
CONFIG_PDL_BMC_MAX_SESSIONS=8

CONFIG_PDL_WATCHDOG_SUPPORT=y

# PDL Debug
CONFIG_DEBUG_PDL=y

# ============================================================================
# ACL (Application Control Layer)
# ============================================================================
CONFIG_ACL=y
CONFIG_ACL_BUILD_STATIC=y
CONFIG_ACL_BUILD_SHARED=y

# ACL Features
CONFIG_ACL_TELEMETRY_CACHE=y
CONFIG_ACL_CACHE_SIZE=1024
CONFIG_ACL_CACHE_TIMEOUT=60

# ACL Debug
CONFIG_DEBUG_ACL=y

# ============================================================================
# Products
# ============================================================================
CONFIG_PRODUCT_CCM=y

# CCM Project Selection
CONFIG_PROJECT_H200_AM625=y

# CCM Libraries
CONFIG_BUILD_LIBCCM=y
CONFIG_LIBCCM_BUILD_STATIC=y
CONFIG_LIBCCM_BUILD_SHARED=y

# CCM Applications (All enabled)
CONFIG_BUILD_CCM_SUPERVISOR=y
CONFIG_CCM_SUPERVISOR_PORT=8001
CONFIG_CCM_SUPERVISOR_LOG_LEVEL=3

CONFIG_BUILD_CCM_COLLECTOR=y
CONFIG_CCM_COLLECTOR_INTERVAL=1000
CONFIG_CCM_COLLECTOR_BUFFER_SIZE=4096

CONFIG_BUILD_CCM_COMM=y
CONFIG_CCM_COMM_PORT=8002
CONFIG_CCM_COMM_MAX_CLIENTS=32

CONFIG_BUILD_CCM_HEALTH=y
CONFIG_CCM_HEALTH_CHECK_INTERVAL=5000
CONFIG_CCM_HEALTH_THRESHOLD=80

CONFIG_BUILD_CCM_LOGGER=y
CONFIG_CCM_LOGGER_MAX_SIZE=10485760
CONFIG_CCM_LOGGER_ROTATE_COUNT=5

# ============================================================================
# Debugging Options
# ============================================================================
CONFIG_DEBUG_SYMBOLS=y
CONFIG_DEBUG_INFO=y
CONFIG_VERBOSE_LOGGING=y
CONFIG_LOG_LEVEL=4

# ============================================================================
# Testing
# ============================================================================
CONFIG_BUILD_TESTS=y
CONFIG_UNIT_TESTS=y
CONFIG_INTEGRATION_TESTS=y
```

## configs/x86_64_minimal_defconfig
```kconfig
#
# EMS x86_64 Minimal Configuration
# Minimal footprint for embedded x86_64 systems
#

# ============================================================================
# Build Options
# ============================================================================
CONFIG_OPT_OS=y
CONFIG_LIBRARY_BUILD_TYPE_STATIC=y

# ============================================================================
# Architecture
# ============================================================================
CONFIG_ARCH_X86_64=y
CONFIG_CROSS_COMPILE=""

# ============================================================================
# OSAL (Operating System Abstraction Layer)
# ============================================================================
CONFIG_OSAL=y
CONFIG_OSAL_BUILD_STATIC=y

# OSAL Features (Minimal)
CONFIG_OSAL_FILE=y
CONFIG_OSAL_IPC=y
CONFIG_OSAL_THREAD=y

# OSAL Resource Limits (Minimal)
CONFIG_OSAL_MAX_TASKS=32
CONFIG_OSAL_MAX_QUEUES=16
CONFIG_OSAL_MAX_MUTEXES=16
CONFIG_OSAL_MAX_SEMAPHORES=16
CONFIG_OSAL_MAX_TIMERS=8

# ============================================================================
# HAL (Hardware Abstraction Layer)
# ============================================================================
CONFIG_HAL=y
CONFIG_HAL_BUILD_STATIC=y

# HAL Drivers (Essential only)
CONFIG_HAL_UART=y
CONFIG_HAL_UART_DEVICE="/dev/ttyS0"
CONFIG_HAL_UART_BAUDRATE=115200

CONFIG_HAL_WATCHDOG=y
CONFIG_HAL_WATCHDOG_DEVICE="/dev/watchdog"
CONFIG_HAL_WATCHDOG_TIMEOUT=30

# ============================================================================
# PCL (Protocol Control Layer)
# ============================================================================
CONFIG_PCL=y
CONFIG_PCL_BUILD_STATIC=y

# ============================================================================
# PDL (Protocol Data Layer)
# ============================================================================
CONFIG_PDL=y
CONFIG_PDL_BUILD_STATIC=y

# PDL Modules (Essential only)
CONFIG_PDL_WATCHDOG_SUPPORT=y

# ============================================================================
# ACL (Application Control Layer)
# ============================================================================
CONFIG_ACL=y
CONFIG_ACL_BUILD_STATIC=y

# ============================================================================
# Products
# ============================================================================
CONFIG_PRODUCT_CCM=y
CONFIG_PROJECT_H200_AM625=y

# CCM Libraries
CONFIG_BUILD_LIBCCM=y
CONFIG_LIBCCM_BUILD_STATIC=y

# CCM Applications (Essential only)
CONFIG_BUILD_CCM_SUPERVISOR=y
CONFIG_CCM_SUPERVISOR_PORT=8001
CONFIG_CCM_SUPERVISOR_LOG_LEVEL=1

CONFIG_BUILD_CCM_LOGGER=y
CONFIG_CCM_LOGGER_MAX_SIZE=1048576
CONFIG_CCM_LOGGER_ROTATE_COUNT=3

# ============================================================================
# Debugging Options (Disabled for minimal build)
# ============================================================================
CONFIG_LOG_LEVEL=1
```

## core/Config.in
```kconfig
# SPDX-License-Identifier: GPL-2.0
# ============================================================================
# Core Modules Configuration
# ============================================================================

menu "Core Modules"

source "core/osal/Config.in"
source "core/hal/Config.in"
source "core/pconfig/Config.in"
source "core/pdl/Config.in"
source "core/prl/Config.in"
source "core/aconfig/Config.in"
source "core/test_framework/Config.in"

# ============================================================================
# Core Modules Testing
# ============================================================================

config BUILD_TESTING
	bool "Build test suite"
	default n
	help
	  Enable building of test suite for core modules.

	  This option controls whether the test framework and test cases
	  are compiled. Tests include:
	  - Unit tests for individual modules (OSAL, HAL, PDL, PRL, etc.)
	  - Performance tests for benchmarking
	  - Stress tests for stability validation
	  - System tests for integration testing

	  The test suite helps ensure code quality and detect regressions
	  during development.

	  Recommended: Enable for development, disable for production.

if BUILD_TESTING
	menu "Test Configuration"
		source "products/core-tests/Config.in"
	endmenu
endif

endmenu
```

## core/Kconfig
```kconfig
# SPDX-License-Identifier: GPL-2.0
# ============================================================================
# Core Modules Configuration
# ============================================================================

menu "Core Modules"

source "core/osal/Kconfig"
source "core/hal/Kconfig"
source "core/pconfig/Kconfig"
source "core/pdl/Kconfig"
source "core/prl/Kconfig"
source "core/aconfig/Kconfig"

endmenu
```

## core/acl/Kconfig
```kconfig
# ACL (Application Configuration Layer) Configuration

config ACL
	bool "ACL (Application Configuration Layer)"
	depends on OSAL && PDL
	default y
	help
	  Application Configuration Layer provides business function to device mapping.
	  ACL depends on OSAL and PDL.

if ACL

config ACL_MAX_DEVICES
	int "Maximum number of devices"
	default 64
	range 1 256
	help
	  Maximum number of devices that can be configured in ACL.

endif # ACL
```

## core/hal/Kconfig
```kconfig
# HAL (Hardware Abstraction Layer) Configuration

config HAL
	bool "HAL (Hardware Abstraction Layer)"
	depends on OSAL
	default y
	help
	  Hardware Abstraction Layer provides unified hardware driver interfaces.
	  HAL depends on OSAL for system calls and platform abstraction.

if HAL

menu "HAL Driver Selection"

config HAL_CAN
	bool "CAN bus driver"
	default y
	help
	  Enable Controller Area Network (CAN) bus driver.
	  Supports SocketCAN interface on Linux.

config HAL_CAN_DEVICE
	string "Default CAN device"
	depends on HAL_CAN
	default "can0"
	help
	  Default CAN device name (e.g., can0, vcan0).

config HAL_UART
	bool "UART driver"
	default y
	help
	  Enable Universal Asynchronous Receiver-Transmitter (UART) driver.

config HAL_UART_DEVICE
	string "Default UART device"
	depends on HAL_UART
	default "/dev/ttyS0"
	help
	  Default UART device path (e.g., /dev/ttyS0, /dev/ttyUSB0).

config HAL_UART_BAUDRATE
	int "Default UART baudrate"
	depends on HAL_UART
	default 115200
	range 9600 921600
	help
	  Default UART communication speed in bits per second.
	  Common values: 9600, 19200, 38400, 57600, 115200, 230400, 460800, 921600

config HAL_UART_DATABITS
	int "UART data bits"
	depends on HAL_UART
	default 8
	range 5 8
	help
	  Number of data bits per character (5-8).

choice
	prompt "UART parity"
	depends on HAL_UART
	default HAL_UART_PARITY_NONE

config HAL_UART_PARITY_NONE
	bool "None"

config HAL_UART_PARITY_ODD
	bool "Odd"

config HAL_UART_PARITY_EVEN
	bool "Even"

endchoice

config HAL_UART_STOPBITS
	int "UART stop bits"
	depends on HAL_UART
	default 1
	range 1 2
	help
	  Number of stop bits (1 or 2).

config HAL_I2C
	bool "I2C bus driver"
	default n
	help
	  Enable Inter-Integrated Circuit (I2C) bus driver.

config HAL_SPI
	bool "SPI bus driver"
	default n
	help
	  Enable Serial Peripheral Interface (SPI) driver.

config HAL_GPIO
	bool "GPIO driver"
	default y
	help
	  Enable General Purpose Input/Output (GPIO) driver.
	  Uses sysfs interface on Linux.

config HAL_WATCHDOG
	bool "Watchdog driver"
	default y
	help
	  Enable hardware watchdog timer driver.

config HAL_WATCHDOG_DEVICE
	string "Watchdog device"
	depends on HAL_WATCHDOG
	default "/dev/watchdog"
	help
	  Watchdog device path.

config HAL_WATCHDOG_TIMEOUT
	int "Default watchdog timeout (seconds)"
	depends on HAL_WATCHDOG
	default 30
	range 1 3600
	help
	  Default watchdog timeout in seconds.

endmenu

endif # HAL
```
