## core/kernel/prl/Config.in
```kconfig
config PRL
	bool "Enable PRL (Protocol Layer)"
	default y
	depends on OSAL
	help
	  Enable Protocol Layer for unified device communication.
	  PRL provides protocol encoding/decoding for internal devices.

if PRL

config PRL_BUILD_SHARED
	bool "Build PRL as shared library"
	default y
	help
	  Build PRL as a shared library (.so) instead of static library (.a).

menu "Device Protocol Selection"

config PRL_MCU
	bool "Enable MCU Device Protocol"
	default y
	help
	  Enable protocol for Microcontroller (MCU) devices.
	  Supports version query, status query, reset, power control, etc.

endmenu

menu "Protocol Features"

config PRL_CRC_CHECK
	bool "Enable CRC16 checksum"
	default y
	help
	  Enable CRC16-CCITT checksum for all protocol packets.

config PRL_SEQUENCE_CHECK
	bool "Enable sequence number check"
	default y
	help
	  Enable sequence number validation for packet ordering.

config PRL_TIMESTAMP_CHECK
	bool "Enable timestamp validation"
	default n
	help
	  Enable timestamp validation for packet freshness.

config PRL_MAX_PAYLOAD_SIZE
	int "Maximum payload size (bytes)"
	default 4096
	range 256 65536
	help
	  Maximum payload size for protocol packets.
	  Larger values allow bigger messages but consume more memory.

endmenu

endif # PRL
```

## core/osal/Kconfig
```kconfig
# OSAL (Operating System Abstraction Layer) Configuration

menu "OSAL (Operating System Abstraction Layer)"

config OSAL
	bool
	default y
	help
	  Operating System Abstraction Layer provides unified OS interfaces.
	  OSAL is the foundation layer required by all other modules.

	  This option is always enabled.

if OSAL

menu "OSAL Features"

config OSAL_FILE
	bool "File I/O support"
	default y
	help
	  Enable file I/O operations (open, read, write, close, etc.).

	  If unsure, say Y.

config OSAL_NETWORK
	bool "Network support"
	default y
	help
	  Enable network socket operations (socket, bind, connect, etc.).
	  Required for network communication.

	  If unsure, say Y.

config OSAL_IPC
	bool "Inter-Process Communication"
	default y
	help
	  Enable IPC mechanisms (mutex, semaphore, shared memory, etc.).
	  Required for multi-threaded applications.

	  If unsure, say Y.

config OSAL_THREAD
	bool "Thread support"
	default y
	help
	  Enable thread management (create, join, detach, etc.).
	  Required for multi-threaded applications.

	  If unsure, say Y.

config OSAL_TIME
	bool "Time and clock support"
	default y
	help
	  Enable time operations (sleep, clock, timer, etc.).

	  If unsure, say Y.

config OSAL_SIGNAL
	bool "Signal handling"
	default y
	help
	  Enable signal handling operations.

	  If unsure, say Y.

endmenu

menu "OSAL Configuration"

config OSAL_MAX_TASKS
	int "Maximum number of tasks"
	default 64
	range 1 256
	help
	  Maximum number of concurrent tasks supported by OSAL.

config OSAL_MAX_QUEUES
	int "Maximum number of queues"
	default 32
	range 1 128
	help
	  Maximum number of message queues.

config OSAL_MAX_MUTEXES
	int "Maximum number of mutexes"
	default 32
	range 1 128
	help
	  Maximum number of mutex locks.

config OSAL_DEBUG_LOGGING
	bool "Enable debug logging"
	default n
	help
	  Enable verbose debug logging in OSAL layer.

choice
	prompt "OSAL library type"
	default OSAL_LIB_TYPE_DEFAULT
	help
	  Select the library type for OSAL.
	  This overrides the global BUILD_SHARED_LIBS setting.

config OSAL_LIB_TYPE_DEFAULT
	bool "Use global setting"
	help
	  Use the global BUILD_SHARED_LIBS setting.

config OSAL_LIB_TYPE_SHARED
	bool "Shared library (.so)"
	help
	  Build OSAL as a shared library.

config OSAL_LIB_TYPE_STATIC
	bool "Static library (.a)"
	help
	  Build OSAL as a static library.

config OSAL_LIB_TYPE_BOTH
	bool "Both shared and static"
	help
	  Build both shared and static versions of OSAL.

endchoice

endmenu

endif # OSAL

endmenu
```

## core/pcl/Kconfig
```kconfig
# PCL (Peripheral Configuration Library) Configuration

config PCL
	bool "PCL (Peripheral Configuration Library)"
	depends on OSAL && HAL
	default y
	help
	  Peripheral Configuration Library provides device-tree-like hardware
	  configuration. PCL depends on OSAL and HAL.

if PCL

choice
	prompt "Platform selection"
	default PCL_PLATFORM_TI_AM625
	help
	  Select the target hardware platform.

config PCL_PLATFORM_TI_AM625
	bool "TI AM625 (Sitara ARM Cortex-A53)"
	help
	  Texas Instruments AM625 SoC platform.

config PCL_PLATFORM_VENDOR_DEMO
	bool "Vendor Demo Platform"
	help
	  Generic vendor demo platform for testing.

endchoice

if PCL_PLATFORM_TI_AM625

choice
	prompt "Product variant"
	default PCL_PRODUCT_H200_100P
	help
	  Select the product variant for TI AM625 platform.

config PCL_PRODUCT_H200_100P
	bool "H200-100P (100W Power Module)"

config PCL_PRODUCT_H200_200P
	bool "H200-200P (200W Power Module)"

endchoice

endif

endif # PCL
```

## core/pdl/Config.in
```kconfig
# PDL (Peripheral Driver Layer) Configuration

menuconfig PDL
	bool "PDL (Peripheral Driver Layer)"
	default n
	depends on OSAL && HAL && PCONFIG
	help
	  Peripheral Driver Layer provides high-level peripheral management
	  and protocol handling.

	  PDL sits above HAL and provides:
	  - Protocol-aware peripheral drivers
	  - Device abstraction (current MCU peripheral type)
	  - State management and error handling
	  - Unified API for complex peripherals

	  Architecture:
	  PDL uses HAL for low-level hardware access and PCONFIG for
	  hardware configuration, providing application-level APIs
	  for managing peripheral subsystems.

	  Memory footprint: ~15KB base + per-peripheral drivers

	  Supported peripherals:
	  - MCU peripherals

	  Dependencies: OSAL, HAL, PCONFIG

	  Note: Enable OSAL, HAL, PCONFIG, and TYPES first in "Core Modules" menu.

	  Recommended: Enable for systems with peripheral management

	  If unsure, say Y.

if PDL

menu "PDL Build Configuration"

config PDL_BUILD_STATIC
	bool "Build static library (.a)"
	default y
	help
	  Build PDL as a static library (libpdl.a).

	  Static linking advantages:
	  - No runtime dependencies
	  - Peripheral drivers embedded in executable
	  - Slightly faster

	  Recommended: Enable for embedded systems

config PDL_BUILD_SHARED
	bool "Build shared library (.so)"
	default n
	help
	  Build PDL as a shared library (libpdl.so).

	  Shared library advantages:
	  - Can update peripheral drivers without recompiling apps
	  - Smaller executable size
	  - Code sharing between processes

	  Recommended: Enable for multi-application systems

endmenu

menuconfig PDL_MCU_SUPPORT
	bool "MCU peripheral support"
	default n
	help
	  Enable MCU (Microcontroller) peripheral support.

	  MCU peripherals are microcontroller-based modules that provide
	  specialized control and monitoring functions, offloading tasks
	  from the main processor.

	  Typical MCU functions:
	  - Real-time sensor data acquisition
	  - PWM control for motors/actuators
	  - Analog signal processing
	  - Low-level protocol handling

	  Communication options:
	  - CAN bus (for robust, multi-drop networks)
	  - UART (for point-to-point connections)

	  Memory footprint: ~8KB base + protocol overhead

	  You can enable CAN-based or UART-based MCU support in the submenu.

	  If unsure, say Y.

source "core/pdl/src/pdl_mcu/Config.in"

endif # PDL
```

## core/pdl/Kconfig
```kconfig
# PDL (Peripheral Driver Layer) Configuration

menuconfig PDL
	bool "PDL (Peripheral Driver Layer)"
	depends on OSAL && HAL && PCL
	default y
	help
	  Peripheral Driver Layer provides unified peripheral management.
	  PDL depends on OSAL, HAL, and PCL.

	  If unsure, say Y.

if PDL

config PDL_SATELLITE_SUPPORT
	bool "Satellite peripheral support"
	depends on HAL_CAN
	default y
	help
	  Enable satellite peripheral management via CAN bus.

config PDL_BMC_SUPPORT
	bool "BMC peripheral support"
	depends on HAL_UART
	default y
	help
	  Enable BMC (Baseboard Management Controller) peripheral support via UART/Ethernet.

config PDL_MCU_SUPPORT
	bool "MCU peripheral support"
	depends on HAL_CAN || HAL_UART
	default y
	help
	  Enable MCU peripheral support via CAN or UART.

config PDL_WATCHDOG_SUPPORT
	bool "Watchdog peripheral support"
	default y
	depends on HAL_WATCHDOG
	help
	  Enable watchdog peripheral support.

endif # PDL
```

## core/types/Kconfig
```kconfig
# SPDX-License-Identifier: GPL-2.0
# ============================================================================
# Types Module Configuration
# ============================================================================

config TYPES
	bool "Enable Types Module"
	default y
	help
	  Core types module provides common type definitions used across
	  multiple core modules (PCL, PDL, etc.).

	  This module contains only type definitions and has no runtime code.
	  It exists to break circular dependencies between PCL and PDL.

	  Dependency relationship:
	  - PCL depends on TYPES (uses config types)
	  - PDL depends on TYPES (uses config types)
	  - PDL depends on PCL (uses config data)
	  - Result: PCL→TYPES←PDL, PDL→PCL (no circular dependency)
```
