## defconfig
```kconfig
#
# EMS Default Configuration
#
CONFIG_EMS_VERSION="1.0.0"

#
# Build Options
#
# CONFIG_BUILD_TYPE_DEBUG is not set
CONFIG_OPT_O2=y
# CONFIG_OPT_O0 is not set
# CONFIG_OPT_O3 is not set
# CONFIG_OPT_OS is not set
CONFIG_BUILD_TESTING=y
# CONFIG_BUILD_SHARED_LIBS is not set
CONFIG_INSTALL_HEADERS=y

#
# Architecture Selection
#
CONFIG_ARCH_X86_64=y
# CONFIG_ARCH_ARM32 is not set
# CONFIG_ARCH_ARM64 is not set
# CONFIG_ARCH_RISCV64 is not set
CONFIG_CROSS_COMPILE=""

#
# OSAL Configuration
#
CONFIG_OSAL=y
CONFIG_OSAL_MAX_TASKS=64
CONFIG_OSAL_MAX_QUEUES=32
CONFIG_OSAL_MAX_MUTEXES=32
# CONFIG_OSAL_DEBUG_LOGGING is not set

#
# HAL Configuration
#
CONFIG_HAL=y
CONFIG_HAL_CAN=y
CONFIG_HAL_UART=y
# CONFIG_HAL_I2C is not set
# CONFIG_HAL_SPI is not set
CONFIG_HAL_GPIO=y
CONFIG_HAL_WATCHDOG=y

#
# PCL Configuration
#
CONFIG_PCL=y

#
# PDL Configuration
#
CONFIG_PDL=y

#
# ACL Configuration
#
CONFIG_ACL=y
CONFIG_ACL_MAX_DEVICES=64

#
# Product Selection
#
CONFIG_PRODUCT_CCM=y
# CONFIG_PRODUCT_SAMPLES is not set
```

## kernel/lpf-configs/Config.in
```kconfig
# LPF Static Config Module Configuration

config LPF_CONFIGS
	tristate "Build selected LPF static config module"
	default m
	depends on LPF_CORE
	depends on m
	help
	  Build lpf_configs.ko from the static platform configuration selected
	  below. This is the C-config equivalent of providing a product DTS:
	  only the selected product configuration is compiled into the module.

choice
	prompt "Selected LPF static config"
	default LPF_CONFIG_KERNEL_X86_MOCK_MODULES if LPF_SOC_ADAPTER_MOCK
	default LPF_CONFIG_KERNEL_X86_MODULES
	depends on LPF_CONFIGS
	help
	  Select the single static platform configuration compiled into
	  lpf_configs.ko.

config LPF_CONFIG_KERNEL_X86_MODULES
	bool "kernel/x86_modules v1"

config LPF_CONFIG_KERNEL_X86_MOCK_MODULES
	bool "kernel/x86_mock_modules v1"

endchoice
```

## kernel/lpf-core/Config.in
```kconfig
# LPF Core Configuration

menuconfig LPF_CORE
	tristate "LPF core device model"
	default m
	depends on OSAL
	depends on m
	help
	  LPF Core owns the framework device and driver registry used by
	  peripheral services. It provides a stable LPF device model above
	  kernel-version and SoC-specific adapter layers, plus snapshot device
	  discovery by stable name and capability.

	  It also contains the initial kernel compatibility wrappers and
	  selected SoC adapter used by LPF hardware access paths.

	  Required by the LPF runtime and services.

	  If unsure, say Y when enabling LPF peripheral services.

if LPF_CORE

choice
	prompt "Default LPF SoC adapter"
	default LPF_SOC_ADAPTER_GENERIC_LINUX
	help
	  Select the SoC adapter registered by LPF Core during module
	  initialization. Product builds should normally use the generic Linux
	  backend or a future SoC-specific backend. Test builds can select the
	  mock backend to validate LPF HW and peripheral-service paths without
	  live hardware.

config LPF_SOC_ADAPTER_GENERIC_LINUX
	bool "Generic Linux SoC adapter"
	help
	  Use standard Linux kernel subsystem wrappers for GPIO, PWM, I2C, SPI,
	  CAN, and serial access.

config LPF_SOC_ADAPTER_MOCK
	bool "Mock SoC adapter"
	help
	  Use an in-kernel mock backend for GPIO, PWM, I2C, SPI, CAN, and
	  serial access. This is intended for framework tests and development
	  builds that need deterministic behavior without real peripherals.

endchoice

menu "LPF Protocol Configuration"

config LPF_PROTOCOL
	bool "LPF peripheral protocol support"
	default n
	help
	  Enable the LPF-owned protocol encoder/decoder used by peripheral
	  services that need framed communication.

	  The protocol layer is part of LPF infrastructure and is linked into
	  lpf_core.ko so services hosted by the integrated LPF peripheral
	  runtime can share the same packet framing implementation.

config LPF_PROTOCOL_MCU
	bool "MCU protocol messages"
	default n
	depends on LPF_PROTOCOL
	help
	  Enable MCU message definitions for the LPF peripheral protocol.

config LPF_PROTOCOL_CRC_CHECK
	bool "Enable CRC16 checksum"
	default y
	depends on LPF_PROTOCOL
	help
	  Enable CRC16-CCITT checksum support for protocol packets.

config LPF_PROTOCOL_SEQUENCE_CHECK
	bool "Enable sequence number check"
	default y
	depends on LPF_PROTOCOL
	help
	  Enable sequence number helpers for packet ordering.

config LPF_PROTOCOL_MAX_PAYLOAD_SIZE
	int "Maximum protocol payload size (bytes)"
	default 4096
	range 256 65536
	depends on LPF_PROTOCOL
	help
	  Maximum payload size for LPF protocol packets.

endmenu

endif # LPF_CORE
```

## kernel/lpf-runtime/Config.in
```kconfig
# LPF Runtime Configuration

menuconfig LPF_RUNTIME
	tristate "LPF runtime module"
	default m
	depends on LPF_CORE
	depends on m
	help
	  Build the integrated LPF runtime module. This module hosts
	  the reusable LPF peripheral services selected below and the runtime
	  configuration backend used to create LPF devices. It keeps framework
	  services in one runtime boundary instead of splitting one kernel
	  module per peripheral.

	  If unsure, say Y when enabling LPF peripheral services.

if LPF_RUNTIME

source "kernel/lpf-runtime/hw/Config.in"

menuconfig LPF_MCU_SERVICE
	bool "LPF MCU peripheral service"
	default n
	depends on LPF_RUNTIME
	select LPF_PROTOCOL
	select LPF_PROTOCOL_MCU
	select LPF_HW_CAN
	select LPF_HW_UART
	help
	  Enable the LPF MCU peripheral service. MCU instances are created from
	  normalized LPF_CONFIG entries and exposed through LPF device lifecycle,
	  /dev/lpf/mcuN, sysfs attributes, and debugfs commands.

source "kernel/lpf-runtime/peripheral/mcu/Config.in"
source "kernel/lpf-runtime/transport/mcu/Config.in"

menuconfig LPF_LED_SERVICE
	bool "LPF LED peripheral service"
	default n
	depends on LPF_RUNTIME
	select LPF_HW_GPIO
	select LPF_HW_PWM
	help
	  Enable the LPF LED peripheral service. LED instances are created from
	  normalized LPF_CONFIG entries and exposed through LPF device lifecycle,
	  /dev/lpf/ledN, sysfs attributes, and debugfs commands.

source "kernel/lpf-runtime/peripheral/led/Config.in"

menu "LPF Runtime Test Configuration"

config LPF_CONFIG_OF_SELFTEST
	bool "Build LPF Device Tree config runtime self-test"
	default n
	depends on LPF_SOC_ADAPTER_MOCK
	help
	  Link the LPF Device Tree config self-test into
	  lpf_runtime.ko. The test contributes an entry to the LPF
	  runtime entry section and validates the LPF Device Tree
	  parser through Linux OF accessors on kernels with CONFIG_OF and
	  CONFIG_OF_DYNAMIC enabled. Kernels without live OF support skip the
	  runtime overlay check, so the same mock defconfig can be used in a
	  broader kernel matrix.

endmenu

endif # LPF_RUNTIME

menu "LPF Core Test Configuration"

config LPF_DUMMY_SERVICE_SELFTEST
	tristate "Build LPF dummy service self-test module"
	default n
	depends on LPF_CORE && LPF_SOC_ADAPTER_MOCK
	depends on m
	help
	  Build lpf_dummy_service_selftest.ko. Loading this module registers
	  a temporary dummy LPF driver and device to validate LPF Core
	  lifecycle, discovery, capability lookup, state/error transitions,
	  event delivery, and removal cleanup without requiring live hardware.

endmenu
```

## kernel/lpf/Config.in
```kconfig
# LPF Core Configuration

menuconfig LPF_CORE
	bool "LPF core device model"
	default n
	depends on OSAL
	help
	  LPF Core owns the framework device and driver registry used by
	  peripheral services. It provides a stable LPF device model above
	  kernel-version and SoC-specific adapter layers, plus snapshot device
	  discovery by stable name and capability.

	  It also contains the initial kernel compatibility wrappers and
	  selected SoC adapter used by HAL backends.

	  Required by PDM and future LPF peripheral service modules.

	  If unsure, say Y when enabling LPF peripheral services.

if LPF_CORE

choice
	prompt "Default LPF SoC adapter"
	default LPF_SOC_ADAPTER_GENERIC_LINUX
	help
	  Select the SoC adapter registered by LPF Core during module
	  initialization. Product builds should normally use the generic Linux
	  backend or a future SoC-specific backend. Test builds can select the
	  mock backend to validate HAL and peripheral-service paths without
	  live hardware.

config LPF_SOC_ADAPTER_GENERIC_LINUX
	bool "Generic Linux SoC adapter"
	help
	  Use standard Linux kernel subsystem wrappers for GPIO, PWM, I2C, SPI,
	  CAN, and serial access.

config LPF_SOC_ADAPTER_MOCK
	bool "Mock SoC adapter"
	help
	  Use an in-kernel mock backend for GPIO, PWM, I2C, SPI, CAN, and
	  serial access. This is intended for framework tests and development
	  builds that need deterministic behavior without real peripherals.

endchoice

endif # LPF_CORE
```

## kernel/pdm-configs/Config.in
```kconfig
# PDM Configuration Module Configuration

config PDM_CONFIGS
	tristate "PDM configuration engine and data providers"
	default m
	depends on OSAL
	depends on m
	help
	  Build pdm_configs.ko. This module owns PDM configuration loading,
	  backend selection, validation, normalization, and the unified
	  configured-device node table consumed by pdm_core.ko.

	  Static platform configuration tables and Device Tree parsing are both
	  implemented inside this module.

if PDM_CONFIGS

config PDM_CONFIG_SOURCE_STATIC
	bool "Enable static platform config provider"
	default y
	help
	  Enable the compiled static platform configuration provider.

config PDM_CONFIG_SOURCE_DT
	bool "Enable Device Tree config provider"
	default y if OF
	depends on OF
	help
	  Enable the Device Tree configuration provider.

menu "PDM Static Platform Config Selection"

depends on PDM_CONFIG_SOURCE_STATIC

choice
	prompt "Selected PDM static config"
	default PDM_CONFIG_UBUNTU_X86_MOCK_MODULES if PDM_SOC_ADAPTER_MOCK
	default PDM_CONFIG_IMX6ULL_MODULES if ARCH_ARM32
	default PDM_CONFIG_UBUNTU_X86_MODULES
	help
	  Select the single static platform configuration compiled into
	  pdm_configs.ko.

config PDM_CONFIG_IMX6ULL_MODULES
	bool "imx6ull/modules v1"

config PDM_CONFIG_UBUNTU_X86_MODULES
	bool "ubuntu/x86_modules v1"

config PDM_CONFIG_UBUNTU_X86_MOCK_MODULES
	bool "ubuntu/x86_mock_modules v1"

endchoice

endmenu

config PDM_CONFIG_OF_SELFTEST
	bool "Build PDM Device Tree config self-test"
	default n
	depends on PDM_CONFIG_SOURCE_DT
	depends on PDM_SOC_ADAPTER_MOCK
	help
	  Build the PDM Device Tree configuration self-test into
	  pdm_configs.ko. This validates the PDM Device Tree parser through
	  Linux OF accessors on kernels with CONFIG_OF enabled.

endif # PDM_CONFIGS
```

## kernel/pdm-core/Config.in
```kconfig
# PDM Core Configuration

menuconfig PDM_CORE
	tristate "PDM core device model"
	default m
	depends on OSAL
	# depends on PDM_CONFIGS  # 已删除：不再依赖 pdm_configs
	depends on m
	help
	  PDM Core owns the framework device and driver registry used by
	  peripheral services. It provides a stable PDM device model above
	  kernel-version and SoC-specific adapter layers, plus snapshot device
	  discovery by stable name and capability.

	  Device configuration now uses Device Tree exclusively.

	  It also contains the initial kernel compatibility wrappers and
	  selected SoC adapter used by PDM hardware access paths.

	  Required by the PDM runtime and services.

	  If unsure, say Y when enabling PDM peripheral services.

if PDM_CORE

config PDM_INSTANCE_DEVNODE_MODE
	string "PDM instance device node mode"
	default "0660"
	help
	  Octal permission mode applied to per-instance PDM misc device nodes
	  under /dev/pdm/, such as /dev/pdm/mcu0 and /dev/pdm/led0.

	  Product builds should keep this conservative and assign device group
	  ownership with udev, devtmpfs policy, or the product init system.
	  Development-only builds that intentionally need broad local access can
	  override this to "0666".

choice
	prompt "Default PDM SoC adapter"
	default PDM_SOC_ADAPTER_GENERIC_LINUX
	help
	  Select the SoC adapter registered by PDM Core during module
	  initialization. Product builds should normally use the generic Linux
	  backend or a future SoC-specific backend. Test builds can select the
	  mock backend to validate PDM HW and peripheral-service paths without
	  live hardware.

config PDM_SOC_ADAPTER_GENERIC_LINUX
	bool "Generic Linux SoC adapter"
	help
	  Use standard Linux kernel subsystem wrappers for GPIO, PWM, I2C, SPI,
	  CAN, and serial access.

config PDM_SOC_ADAPTER_MOCK
	bool "Mock SoC adapter"
	help
	  Use an in-kernel mock backend for GPIO, PWM, I2C, SPI, CAN, and
	  serial access. This is intended for framework tests and development
	  builds that need deterministic behavior without real peripherals.

endchoice

# menu "PDM Protocol Configuration" - 已删除：protocol 模块已删除

# menuconfig PDM_RUNTIME - 已删除：无实际作用
# menuconfig PDM_MCU_SERVICE - 已删除：依赖 pdm_configs
# menuconfig PDM_LED_SERVICE - 已删除：依赖 pdm_configs

# menu "PDM Core Test Configuration" - 已删除：selftest 已删除

endif # PDM_CORE
```

## kernel/pdm-core/hw/Config.in
```kconfig
# PDM HW configuration

menu "Platform Configuration"

config PLATFORM_LINUX
	bool "Linux platform"
	default n
	depends on OS_LINUX
	help
	  Enable Linux hardware access support.

	  Uses Linux kernel interfaces:
	  - SocketCAN kernel sockets for CAN bus
	  - TTY, GPIO, I2C, and SPI kernel subsystems

	  Suitable for Linux systems with standard kernel drivers.

endmenu

menu "PDM HW Configuration"

config PDM_HW_CAN
	bool "PDM HW CAN transport support"
	default n
	depends on PDM_RUNTIME
	help
	  Enable the PDM HW CAN transport path used by peripheral services.

config PDM_HW_UART
	bool "PDM HW UART transport support"
	default n
	depends on PDM_RUNTIME
	help
	  Enable the PDM HW UART transport path used by peripheral services.

config PDM_HW_I2C
	bool "PDM HW I2C bus support"
	default n
	depends on PDM_RUNTIME
	help
	  Enable the PDM HW I2C bus path used by peripheral services.

config PDM_HW_SPI
	bool "PDM HW SPI bus support"
	default n
	depends on PDM_RUNTIME
	help
	  Enable the PDM HW SPI bus path used by peripheral services.

config PDM_HW_GPIO
	bool "PDM HW GPIO control support"
	default n
	depends on PDM_RUNTIME
	help
	  Enable the PDM HW GPIO control path used by peripheral services.

config PDM_HW_PWM
	bool "PDM HW PWM control support"
	default n
	depends on PDM_RUNTIME
	help
	  Enable the PDM HW PWM control path used by peripheral services.

config PDM_HW_MOCK_SELFTEST
	tristate "Build PDM HW mock backend self-test module"
	depends on PDM_SOC_ADAPTER_MOCK && PDM_RUNTIME
	depends on m
	select PDM_HW_CAN
	select PDM_HW_UART
	select PDM_HW_I2C
	select PDM_HW_SPI
	select PDM_HW_GPIO
	select PDM_HW_PWM
	help
	  Build pdm_hw_mock_selftest.ko. Loading this module runs PDM HW
	  GPIO, PWM, CAN, UART, I2C, and SPI operation checks through the
	  mock SoC adapter.

endmenu
```

## kernel/pdm-core/peripheral/mcu/Config.in
```kconfig
# PDM MCU service configuration

if PDM_MCU_SERVICE

config PDM_MCU_MAX_DEVICES
	int "Maximum number of MCU devices"
	default 4
	range 1 16
	help
	  Maximum number of MCU devices that can be managed simultaneously.
	  Each device requires approximately 200 bytes of RAM.

config PDM_MCU_TRANSPORT_CAN
	bool "PDM MCU CAN transport"
	default y
	depends on PDM_HW_CAN
	help
	  Enable the CAN-backed transport implementation used by the PDM MCU
	  service for PDM_CONFIG_MCU_INTERFACE_CAN entries.

config PDM_MCU_TRANSPORT_UART
	bool "PDM MCU UART transport"
	default y
	depends on PDM_HW_UART
	help
	  Enable the UART-backed transport implementation used by the PDM MCU
	  service for PDM_CONFIG_MCU_INTERFACE_SERIAL entries.

endif # PDM_MCU_SERVICE
```
