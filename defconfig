## kernel/pdm/Config.in
```kconfig
# PDM Core Configuration

menuconfig PDM_CORE
	tristate "PDM core device model"
	default m
	depends on OSAL
	depends on m
	help
	  PDM Core provides a Linux bus_type implementation for PDM devices.
	  Device configuration uses Device Tree exclusively.

	  If unsure, say Y when enabling PDM peripheral services.

if PDM_CORE

config PDM_INSTANCE_DEVNODE_MODE
	string "PDM instance device node mode"
	default "0660"
	help
	  Octal permission mode applied to per-instance PDM character device nodes
	  under /dev/pdm/, such as /dev/pdm/mcu0 and /dev/pdm/led0.

	  Product builds should keep this conservative and assign device group
	  ownership with udev, devtmpfs policy, or the product init system.
	  Development-only builds that intentionally need broad local access can
	  override this to "0666".

config PDM_MOCK_DEVICES
	bool "Synthetic PDM devices for module smoke tests"
	default n
	help
	  Create in-kernel mock PDM MCU and LED devices when pdm_core loads.
	  This is intended for x86 smoke tests that do not have Device Tree
	  PDM child nodes. Product builds should leave this disabled.

endif # PDM_CORE
```

## products/Config.in
```kconfig
# ============================================================================
# Products Configuration
# ============================================================================
# Generic embedded middleware framework entry point.
# ============================================================================

menu "Products"

config PRODUCT_FRAMEWORK
	bool "Generic embedded middleware framework"
	default y
	help
	  Build the generic embedded middleware framework without any
	  product-specific business layer.

endmenu
```

## products/Kconfig
```kconfig
# ============================================================================
# Products Configuration
# ============================================================================
# This file organizes all product configurations in a hierarchical menu
# structure, similar to Linux kernel's drivers/ subsystem.
# ============================================================================

menu "Products"

# Source individual product Kconfig files
# Each product defines its own menuconfig entry for a collapsible submenu

source "products/ccm/Kconfig"
source "products/samples/Kconfig"

endmenu
```

## products/ccm/Kconfig
```kconfig
# ============================================================================
# CCM Product Configuration
# ============================================================================
# CCM (Central Control Module) is a satellite payload control and data
# management system designed for H200 platform with AM625 SoC.
# ============================================================================

menu "CCM Product"

# ============================================================================
# Product Components
# ============================================================================

menu "Product Components"

osource "$SDK_PATH/products/ccm/components/libccm/Kconfig"
osource "$SDK_PATH/products/ccm/components/h200_am625/Kconfig"

endmenu

# ============================================================================
# Applications
# ============================================================================

menu "Applications"

osource "$SDK_PATH/products/ccm/apps/app_collector/Kconfig"
osource "$SDK_PATH/products/ccm/apps/app_comm/Kconfig"
osource "$SDK_PATH/products/ccm/apps/app_health/Kconfig"
osource "$SDK_PATH/products/ccm/apps/app_logger/Kconfig"
osource "$SDK_PATH/products/ccm/apps/app_supervisor/Kconfig"

endmenu

endmenu
```

## products/ccm/apps/app_collector/Config.in
```kconfig
config APP_COLLECTOR
    bool "Enable CCM Collector Application"
    default n
    select OSAL
    select HAL
    select PCONFIG
    select PDL
    select ACONFIG
    select H200_AM625
    select LIBCCM
    help
      CCM data collector application.
      Collects telemetry data from satellite and stores locally.
```

## products/ccm/apps/app_comm/Config.in
```kconfig
config APP_COMM
    bool "Enable CCM Communication Application"
    default n
    select OSAL
    select HAL
    select PCONFIG
    select PDL
    select ACONFIG
    select H200_AM625
    select LIBCCM
    help
      CCM communication application.
      Handles communication between satellite platform and ground station.
```

## products/ccm/apps/app_health/Kconfig
```kconfig
config APP_HEALTH
    bool "Enable CCM Health Monitor Application"
    default y
    select OSAL
    select HAL
    select PCL
    select PDL
    select ACL
    select H200_AM625
    select LIBCCM
    help
      CCM health monitoring application.
      Monitors system health and reports status.
```

## products/core-tests/unit/Config.in
```kconfig
# Unit Test Configuration
#
# This file provides fine-grained control over individual unit test files.
# Each test file can be independently enabled/disabled through menuconfig.

if TEST_UNIT

# Source layer-specific Config.in files
source "products/core-tests/unit/osal/Config.in"
source "products/core-tests/unit/hal/Config.in"
source "products/core-tests/unit/pdl/Config.in"
source "products/core-tests/unit/prl/Config.in"
source "products/core-tests/unit/pconfig/Config.in"
source "products/core-tests/unit/aconfig/Config.in"

endif # TEST_UNIT
```

## products/ctest/unit/pdi/Config.in
```kconfig
# PDI Unit Test Configuration
#
# Fine-grained control for individual PDI userspace API test files.

if TEST_PDI

menu "PDI Unit Tests"

config TEST_PDI_API
	bool "PDI userspace API validation tests"
	default y
	help
	  Test PDI argument validation and unavailable-device behavior.
	  These tests do not require pdm.ko to be loaded.

endmenu

endif # TEST_PDI
```

## products/pmc/Kconfig
```kconfig
# PMC (Power Management Controller) Product Configuration

choice
	prompt "PMC Project"
	default PROJECT_H200_AM625
	help
	  Select the PMC project variant.

config PROJECT_H200_AM625
	bool "H200 AM625 Project"
	help
	  H200 project based on TI AM625 SoC.

endchoice

menu "PMC Applications"

config BUILD_PMC_SUPERVISOR
	bool "Build PMC Supervisor"
	default y
	help
	  Build the PMC supervisor application.

config BUILD_PMC_COLLECTOR
	bool "Build PMC Collector"
	default y
	help
	  Build the PMC data collector application.

config BUILD_PMC_COMM
	bool "Build PMC Communication"
	default y
	help
	  Build the PMC communication application.

config BUILD_PMC_HEALTH
	bool "Build PMC Health Monitor"
	default y
	help
	  Build the PMC health monitoring application.

config BUILD_PMC_LOGGER
	bool "Build PMC Logger"
	default y
	help
	  Build the PMC logging application.

endmenu
```

## products/pmc/apps/test_call_chain/Config.in
```kconfig
config TEST_CALL_CHAIN
	bool "Test Call Chain Application"
	default n
	depends on OSAL && HAL && PDL && PCONFIG && ACONFIG
	help
	  Complete call chain test application.

	  This application tests the complete call chain from APP layer
	  through ACONFIG, PDL, PCONFIG to HAL layer.

	  Test functions:
	    - TestCallChain_MCU_CAN() - Test a TC mapping resolved through MCU path
	    - TestCallChain_MCU_Serial() - Test a second MCU-backed TC mapping
	    - TestCallChain_PowerControl() - Test power-control TC mapping
	    - TestCallChain_RunAll() - Run all tests

	  This is a debug/verification tool and should not be included
	  in production builds.
```

## products/sample/Kconfig
```kconfig
# ============================================================================
# Sample Product Configuration
# ============================================================================
# Sample product provides a minimal working example showing how to structure
# a product using the EMS SDK framework.
# ============================================================================

menu "Sample Product"

# ============================================================================
# Applications
# ============================================================================

menu "Applications"

osource "$SDK_PATH/products/sample/apps/app_demo/Kconfig"

endmenu

endmenu
```

## products/samples/Kconfig
```kconfig
# Sample Applications Configuration

config BUILD_SAMPLE_APP
	bool "Build sample application"
	default y
	help
	  Build the basic sample application demonstrating EMS usage.

config BUILD_WATCHDOG_APP
	bool "Build watchdog application"
	default y
	help
	  Build the watchdog demonstration application.
```

## tests/Kconfig
```kconfig
# Test Configuration

config TEST_OSAL
	bool "Build OSAL tests"
	depends on BUILD_TESTING
	default y
	help
	  Build OSAL layer unit tests.

config TEST_HAL
	bool "Build HAL tests"
	depends on BUILD_TESTING
	default y
	help
	  Build HAL layer unit tests.

config TEST_PCL
	bool "Build PCL tests"
	depends on BUILD_TESTING
	default y
	help
	  Build PCL layer unit tests.

config TEST_PDL
	bool "Build PDL tests"
	depends on BUILD_TESTING
	default y
	help
	  Build PDL layer unit tests.

config TEST_ACL
	bool "Build ACL tests"
	depends on BUILD_TESTING
	default y
	help
	  Build ACL layer unit tests.
```

## user/pdi/Config.in
```kconfig
# PDI (Peripheral Driver Interface) Configuration

menuconfig PDI
	bool "PDI (Peripheral Driver Interface)"
	default n
	help
	  Userspace API library for PDM kernel peripheral devices.

	  PDI owns the userspace API surface, including device discovery
	  through the PDM control node /dev/pdm_manager and peripheral APIs such
	  as /dev/pdm/mcuN and /dev/pdm/ledN.

if PDI


menu "PDI logging"

config PDI_LOGGING_ENABLE
	bool "Enable PDI userspace logging"
	default y
	help
	  Enable the lightweight LOG_* interface owned by PDI.

if PDI_LOGGING_ENABLE

choice
	prompt "PDI userspace log level"
	default PDI_LOG_LEVEL_INFO if BUILD_TYPE_DEBUG
	default PDI_LOG_LEVEL_WARN if BUILD_TYPE_RELEASE
	default PDI_LOG_LEVEL_INFO
	help
	  Select the minimum PDI log priority compiled into userspace PDI.

config PDI_LOG_LEVEL_FATAL
	bool "FATAL - fatal errors only"

config PDI_LOG_LEVEL_ERROR
	bool "ERROR - errors and above"

config PDI_LOG_LEVEL_WARN
	bool "WARN - warnings and above"

config PDI_LOG_LEVEL_INFO
	bool "INFO - informational and above"

config PDI_LOG_LEVEL_DEBUG
	bool "DEBUG - debug and above"

endchoice

endif # PDI_LOGGING_ENABLE

endmenu

config PDI_BUILD_STATIC
	bool "Build static library (.a)"
	default y

config PDI_BUILD_SHARED
	bool "Build shared library (.so)"
	default n

endif # PDI
```
